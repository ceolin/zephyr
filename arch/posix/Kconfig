## arch/posix/Kconfig
```kconfig
# General configuration options

# Copyright (c) 2017 Intel Corporation
# SPDX-License-Identifier: Apache-2.0

menu "Native (POSIX) Architecture Options"
	depends on ARCH_POSIX

config ARCH
	default "posix"

config ARCH_POSIX_PAGE_SIZE
	int
	default 4096
	help
	  Page size of the host, in bytes. This is the granularity of the
	  memory protection used for user mode. It is checked at runtime.

config ARCH_POSIX_USERSPACE
	def_bool y
	depends on NATIVE_LIBRARY && BUILD_OUTPUT_EXE
	depends on NATIVE_SIMULATOR_NUMBER_MCUS = 1 && NATIVE_SIMULATOR_EXTRA_IMAGE_PATHS = ""
	depends on !ASAN && !MSAN && !COVERAGE && !ARCH_POSIX_LIBFUZZER
	select EXPERIMENTAL if USERSPACE
	select ARCH_HAS_USERSPACE
	select ARCH_HAS_SW_MEM_PROTECTION
	select ARCH_HAS_THREAD_PRIV_STACK_SPACE_GET
	select ARCH_MEM_DOMAIN_SUPPORTS_ISOLATED_STACKS
	help
	  The build supports user mode threads (CONFIG_USERSPACE) on this
	  architecture. User mode support is experimental.

	  The memory protection is emulated on the host: while a user thread
	  runs, the RAM of the Zephyr image is made inaccessible, except for
	  the thread stack and the partitions of its memory domain, with the
	  memory protection keys of the host if it supports them, or with the
	  page permissions otherwise. System calls switch to a privileged stack
	  and restore access, and invalid accesses done in user mode are
	  reported as fatal errors of the faulting thread.

	  This is meant for developing and testing user mode code. It is not a
	  security boundary: any code in the process can change the memory
	  permissions, and memory outside of the Zephyr image RAM (like the
	  host C library state or the host heap) is not protected.

config ARCH_POSIX_USER_STACK_MIN_SIZE
	int "Minimum size of user mode thread stacks"
	default 8192
	depends on USERSPACE
	help
	  User mode threads run on their Zephyr thread stack, unlike kernel
	  threads which use the host pthread stack. Code built for the host
	  needs more stack than typical embedded targets, so user mode capable
	  stacks are enlarged to at least this size (in bytes, rounded up to
	  the page size).

config ARCH_POSIX_UPDATE_STACK_INFO
	bool "Update thread stack info with real pthread stack bounds"
	depends on THREAD_STACK_INFO
	depends on !USERSPACE
	help
	  When enabled, the POSIX architecture will update each thread's
	  stack_info to reflect the actual pthread stack instead of the
	  Zephyr-allocated stack. This is useful for applications that
	  perform their own stack overflow checking against the real
	  stack bounds.

config ARCH_POSIX_RECOMMENDED_STACK_SIZE
	int
	default 60 if 64BIT && ARCH_POSIX_UPDATE_STACK_INFO && STACK_SENTINEL
	default 56 if 64BIT && ARCH_POSIX_UPDATE_STACK_INFO
	default 44 if 64BIT && STACK_SENTINEL
	default 40 if 64BIT
	default 36 if ARCH_POSIX_UPDATE_STACK_INFO && STACK_SENTINEL
	default 32 if ARCH_POSIX_UPDATE_STACK_INFO
	default 28 if STACK_SENTINEL
	default 24
	help
	  In bytes, stack size for Zephyr threads meant only for the POSIX
	  architecture.
	  (In this architecture the Zephyr thread stack is not used as call stack,
	  the real stack is the native underlying pthread stack.
	  Therefore the allocated stack can be limited to this size)

config ARCH_POSIX_LIBFUZZER
	bool "Build fuzz test target"
	help
	  Build as an LLVM libfuzzer target. Requires
	  support from the toolchain (currently only clang works, and
	  only on native_sim[//64]), and should normally be used in
	  concert with some of CONFIG_ASAN/UBSAN/MSAN for validation.
	  The application needs to implement the
	  LLVMFuzzerTestOneInput() entry point, which runs in the host
	  environment "outside" the OS.  See Zephyr documentation and
	  sample and https://llvm.org/docs/LibFuzzer.html for more
	  information.

config ARCH_POSIX_TRAP_ON_FATAL
	bool "Raise a SIGTRAP on fatal error"
	help
	  Raise a SIGTRAP signal on fatal error before exiting.
	  This automatically suspends the target if a debugger is attached.

rsource "Kconfig.natsim_optional"

endmenu
```
