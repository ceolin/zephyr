## dts/bindings/base/pm.yaml
```yaml
# Copyright (c) 2021 Intel Corporation.
# SPDX-License-Identifier: Apache-2.0

# Properties for Power Management (PM)

properties:
    wakeup-source:
      required: false
      type: boolean
      description: |
        Property to identify that a device can be used as wake up source.

        When this property is provided a specific flag is set into the
        device that tells the system that the device is capable of
        wake up the system.

        Wake up capable devices are disabled (interruptions will not wake up
        the system) by default but they can be enabled at runtime if necessary.

    wakeup-constraints:
       type: phandles
       required: false
       description: |

         List of power management states which the device can not operate as
         wake up source. The pm subsystem will automatically set consraints
         in these states when the device is used as wake up source.
```

## dts/bindings/base/power.yaml
```yaml
# Copyright (c) 2020, Nordic Semiconductor ASA
# SPDX-License-Identifier: Apache-2.0

# Properties for nodes with controllable power supplies.

properties:
    supply-gpios:
      type: phandle-array
      required: false
      description: |
        GPIO specifier that controls power to the device.

        This property should be provided when the device has a dedicated
        switch that controls power to the device.  The supply state is
        entirely the responsibility of the device driver.

        Contrast with vin-supply.

    vin-supply:
      type: phandle
      required: false
      description: |
        Reference to the regulator that controls power to the device.
        The referenced devicetree node must have a regulator compatible.

        This property should be provided when device power is supplied
        by a shared regulator.  The supply state is dependent on the
        request status of all devices fed by the regulator.

        Contrast with supply-gpios.  If both properties are provided
        then the regulator must be requested before the supply GPIOS is
        set to an active state, and the supply GPIOS must be set to an
        inactive state before releasing the regulator.

    wakeup-source:
      required: false
      type: boolean
      description: |
        Property to identify that a device can be used as wake up source.

        When this property is provided a specific flag is set into the
        device that tells the system that the device is capable of
        wake up the system.

        Wake up capable devices are enabled (interruptions will wake up
        the system) by default but they can be disabled at runtime if necessary.
```

## tests/net/pm/Kconfig
```kconfig
# Private config options for net pm test

# Copyright (c) 2020 Intel Corporation
# SPDX-License-Identifier: Apache-2.0

mainmenu "Network Power-Management test"

config FAKE_DEV
	def_bool y
	select NET_POWER_MANAGEMENT if PM || PM_DEVICE_RUNTIME

source "Kconfig.zephyr"
```
