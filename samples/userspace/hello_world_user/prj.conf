## prj.conf
```kconfig
CONFIG_USERSPACE=y
CONFIG_APPLICATION_DEFINED_SYSCALL=y
CONFIG_ASSERT=y
CONFIG_LOG=y
CONFIG_LOG_MODE_MINIMAL=y
CONFIG_MAIN_STACK_SIZE=4096
CONFIG_DYNAMIC_THREAD_STACK_SIZE=24576
CONFIG_HEAP_MEM_POOL_SIZE=20000
CONFIG_DYNAMIC_THREAD=y
CONFIG_DYNAMIC_THREAD_PREFER_ALLOC=y
CONFIG_DYNAMIC_THREAD_ALLOC=y
CONFIG_DYNAMIC_OBJECTS=y
CONFIG_MP_MAX_NUM_CPUS=1
```

## src/main.c
```c
/*
 * Copyright (c) 2020 BayLibre, SAS
 *
 * SPDX-License-Identifier: Apache-2.0
 */

#include <zephyr/kernel.h>
#include <stdio.h>
#define USER_STACKSIZE	2048

struct k_thread user_thread;
K_THREAD_STACK_DEFINE(user_stack, USER_STACKSIZE);

static void user_function(void *p1, void *p2, void *p3)
{
	printf("Hello World from %s (%s)\n",
	       k_is_user_context() ? "UserSpace!" : "privileged mode.",
	       CONFIG_BOARD);
	__ASSERT(k_is_user_context(), "User mode execution was expected");
}

int main(void)
{
	k_tid_t tid;
	k_thread_stack_t *stack;

	k_thread_system_pool_assign(k_current_get());

	stack = k_thread_stack_alloc(USER_STACKSIZE, K_USER);
	tid = k_thread_create(&user_thread, stack, USER_STACKSIZE,
			user_function, NULL, NULL, NULL,
			-1, K_USER, K_MSEC(0));

	k_thread_join(tid, K_FOREVER);
	k_thread_stack_free(stack);

	return 0;
}
```
