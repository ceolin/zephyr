## prj.conf
```kconfig
CONFIG_PM=y
CONFIG_PM_POLICY_DEVICE_CONSTRAINTS=y
CONFIG_ZTEST=y
```

## src/main.c
```c
/*
 * Copyright (c) 2020 Intel Corporation.
 *
 * SPDX-License-Identifier: Apache-2.0
 */

#include <zephyr/kernel.h>
#include <zephyr/ztest.h>
#include <zephyr/pm/pm.h>

/* Last state has not declared a minimum residency, so it should be
 * set the default 0 value
 */
static struct pm_state_info infos[] = {{PM_STATE_SUSPEND_TO_IDLE, 0, false, 10000, 100},
	{PM_STATE_SUSPEND_TO_RAM, 0, false, 50000, 500}, {PM_STATE_STANDBY, 0, false, 0}};
static enum pm_state states[] = {PM_STATE_SUSPEND_TO_IDLE,
			PM_STATE_SUSPEND_TO_RAM, PM_STATE_STANDBY};
static enum pm_state wrong_states[] = {PM_STATE_SUSPEND_TO_DISK,
		PM_STATE_SUSPEND_TO_RAM, PM_STATE_SUSPEND_TO_RAM};

ZTEST(power_states_1cpu, test_power_states)
{
	enum pm_state dts_states[] =
		PM_STATE_LIST_FROM_DT_CPU(DT_NODELABEL(cpu0));
	struct pm_state_info dts_infos[] =
		PM_STATE_INFO_LIST_FROM_DT_CPU(DT_NODELABEL(cpu0));
	uint32_t dts_states_len =
		DT_NUM_CPU_POWER_STATES(DT_NODELABEL(cpu0));

	zassert_true(ARRAY_SIZE(states) == dts_states_len,
		     "Invalid number of pm states");
	zassert_true(memcmp(infos, dts_infos, sizeof(dts_infos)) == 0,
		     "Invalid pm_state_info array");
	zassert_true(memcmp(states, dts_states, sizeof(dts_states)) == 0,
		     "Invalid pm-states array");

	zassert_false(memcmp(wrong_states, dts_states, sizeof(dts_states)) == 0,
		     "Invalid pm-states array");
}

ZTEST_SUITE(power_states_1cpu, NULL, NULL, ztest_simple_1cpu_before,
			ztest_simple_1cpu_after, NULL);
```

## src/test_driver.c
```c
/*
 * Copyright (c) 2024 Intel Corporation
 *
 * SPDX-License-Identifier: Apache-2.0
 */

#include "test_driver.h"

#include <zephyr/kernel.h>
#include <zephyr/pm/policy.h>
#include <zephyr/pm/device.h>
#include <zephyr/ztest.h>

struct test_driver_data {
	const struct device *self;
	struct k_timer timer;
	bool ongoing;
};

static int test_driver_action(const struct device *dev,
			      enum pm_device_action action,
			      const struct pm_state_info *soc_state)
{
	ARG_UNUSED(dev);
	ARG_UNUSED(action);
	ARG_UNUSED(soc_state);

	return 0;
}

static void timer_expire_cb(struct k_timer *timer)
{
	struct test_driver_data *data = k_timer_user_data_get(timer);

	data->ongoing = false;
	k_timer_stop(timer);
	pm_policy_device_power_lock_put(data->self);
}

void test_driver_async_operation(const struct device *dev)
{
	struct test_driver_data *data = dev->data;

	data->ongoing = true;
	pm_policy_device_power_lock_get(dev);

	/** Lets set a timer big enough to ensure that any deep
	 *  sleep state would be suitable but constraints will
	 *  make only state0 (suspend-to-idle) will be used.
	 */
	k_timer_start(&data->timer, K_MSEC(500), K_NO_WAIT);
}

int test_driver_init(const struct device *dev)
{
	struct test_driver_data *data = dev->data;

	data->self = dev;

	k_timer_init(&data->timer, timer_expire_cb, NULL);
	k_timer_user_data_set(&data->timer, data);

	return 0;
}

PM_DEVICE_DT_DEFINE(DT_NODELABEL(test_dev), test_driver_action);

static struct test_driver_data data;

DEVICE_DT_DEFINE(DT_NODELABEL(test_dev), test_driver_init,
	      PM_DEVICE_DT_GET(DT_NODELABEL(test_dev)), &data, NULL, POST_KERNEL,
	      CONFIG_KERNEL_INIT_PRIORITY_DEVICE, NULL);
```
